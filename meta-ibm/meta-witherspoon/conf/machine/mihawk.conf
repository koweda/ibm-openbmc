## meta-ibm/meta-witherspoon/conf/machine/mihawk.conf
```bitbake
KMACHINE = "aspeed"
KERNEL_DEVICETREE = "${KMACHINE}-bmc-opp-${MACHINE}.dtb"
KERNEL_FEATURES_append = " phosphor-wdt-on-panic"

# 64MB flash size
UBOOT_MACHINE = "evb-ast2500_defconfig"
UBOOT_DEVICETREE = "ast2500-evb"
FLASH_SIZE = "65536"

# Fixed partition offsets
FLASH_KERNEL_OFFSET = "1024"
FLASH_ROFS_OFFSET = "10240"
FLASH_RWFS_OFFSET = "43008"

OBMC_POWER_SUPPLY_INSTANCES = "0 1"

PREFERRED_PROVIDER_virtual/p9-vcs-workaround = ''
PREFERRED_PROVIDER_virtual/openpower-fru-vpd-layout = "mihawk-openpower-fru-vpd-layout-native"

require conf/machine/include/ast2500.inc
require conf/machine/include/obmc-bsp-common.inc
require conf/machine/include/openpower.inc
require conf/machine/include/p9.inc
require conf/distro/include/phosphor-aspeednic-use-mac2.inc

PHOSPHOR_MRW_LICENSE = "Apache-2.0"
PHOSPHOR_MRW_LIC_FILES_CHKSUM = "file://LICENSE;md5=86d3f3a95c324c9479bd8986968f4327"
PHOSPHOR_MRW_URI = "git://github.com/open-power/mihawk-xml"
PHOSPHOR_MRW_REV = "f6ec5aa0f9803d44b147a7670dec7ec935f59582"

PREFERRED_PROVIDER_virtual/bootloader = "u-boot-aspeed-sdk"
PREFERRED_PROVIDER_u-boot = "u-boot-aspeed-sdk"
PREFERRED_PROVIDER_u-boot-fw-utils = "u-boot-fw-utils-aspeed-sdk"

# Inhibit phosphor-hwmon-config-mrw
VIRTUAL-RUNTIME_phosphor-hwmon-config_df-mrw = ""

# Inhibit phosphor-fan-presence-mrw-native
PREFERRED_PROVIDER_virtual/phosphor-fan-presence-config_df-mrw = \
    "phosphor-fan-presence-config"

# Inhibit phosphor-fan-control-fan-config-mrw-native
PREFERRED_PROVIDER_virtual/phosphor-fan-control-fan-config_df-mrw = \
    "phosphor-fan-control-fan-config"

# Inhibit mihawk-led-manager-config-native
PREFERRED_PROVIDER_virtual/phosphor-led-manager-config-native_df-mrw = \
    "mihawk-led-manager-config-native"

PREFERRED_PROVIDER_virtual/phosphor-logging-callouts_df-mrw = "mihawk-phosphor-logging-callouts-native"

PREFERRED_PROVIDER_virtual/openpower-fru-inventory_df-mrw = "mihawk-openpower-fru-inventory-native"
```
